#include <ESP8266WiFi.h>
#include <ESP8266WiFiMulti.h>
#include "DHT.h" 
#include <SPI.h>
#include <Wire.h>
#include <Adafruit_GFX.h>
#include <Adafruit_SSD1306.h>

#define DHTTYPE DHT11   // DHT 11
// Definimos parámetros
#define WIFISID "MiHogar"
#define WIFIPASS "Kamilo2016"

// Definimos los parámetros para el IFTTT
#define HOSTIFTTT "maker.ifttt.com"
#define EVENTO "Lab_control"
#define IFTTTKEY "POikm4lflsmBUpxBmYSS9"

#define SDHT D7
#define SGROUND A0
#define BUZZER D6
#define INDICADOR 2

#define S_HOME 0
#define S_MENU 1

#define BTN_U  0
#define BTN_O 1
#define INDICADOR 2

Adafruit_SSD1306 display(-1);

DHT dht(SDHT, DHTTYPE); 

ESP8266WiFiMulti WiFiMulti;
 
// Utilizamos la conexión SSL del ESP8266
WiFiClientSecure client;
 
// Variable que permite ejecutar una sola vez la función
bool ejecutado = false;
 


uint8_t state = S_HOME; 

const unsigned char Ixhua [] PROGMEM = {// 'Ixhua (7)', 128x64px
0x00, 0x00, 0x00, 0x00, 0x00, 0x00, 0x00, 0x00, 0x00, 0x00, 0x00, 0x00, 0x00, 0x00, 0x00, 0x00,
0x00, 0x00, 0x00, 0x00, 0x00, 0x00, 0x00, 0x00, 0x00, 0x00, 0x00, 0x00, 0x00, 0x00, 0x00, 0x00,
0x00, 0x00, 0x00, 0x00, 0x00, 0x00, 0x00, 0x00, 0x00, 0x00, 0x00, 0x00, 0x00, 0x00, 0x00, 0x00,
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0xff, 0xff, 0xff, 0xff, 0xff, 0xff, 0xff, 0xff, 0xff, 0xff, 0xff, 0xff, 0xff, 0xff, 0xff, 0xff};

const unsigned char Happy [] PROGMEM = { // '2', 128x64px
0xff, 0xff, 0xff, 0xff, 0xff, 0xff, 0xff, 0xff, 0xff, 0xff, 0xff, 0xff, 0xff, 0xff, 0xff, 0xff,
0xff, 0xff, 0xff, 0xff, 0xff, 0xff, 0xff, 0xff, 0xff, 0xff, 0xff, 0xff, 0xff, 0xff, 0xff, 0xff,
0xff, 0xff, 0xff, 0xff, 0xff, 0xff, 0xff, 0xff, 0xff, 0xff, 0xff, 0xff, 0xff, 0xff, 0xff, 0xff,
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0xff, 0xff, 0xff, 0xff, 0xff, 0xff, 0xff, 0xff, 0xff, 0xff, 0xff, 0xff, 0xff, 0xff, 0xff, 0xff
};

 uint8_t button[2] = {
    12,
    16
  };

uint8_t button_estate[2];

//Como parametro tenemos el boton 
uint8_t flancoSubida(int btn) {
  uint8_t valor_nuevo = digitalRead(button[btn]);
  uint8_t result = button_estate[btn]!=valor_nuevo && valor_nuevo == 1;
  button_estate[btn] = valor_nuevo;
  return result;
}

void setup()   
{           
    state = S_HOME;     
    Serial.begin(115200);
	
    dht.begin();
    delay(10);
    
    pinMode(INDICADOR,OUTPUT);
    pinMode(SDHT,OUTPUT);
    pinMode(SGROUND, OUTPUT);
    digitalWrite(INDICADOR,HIGH);
    
    pinMode(button[BTN_U], INPUT_PULLUP);
    pinMode(button[BTN_O], INPUT_PULLUP);

    display.begin(SSD1306_SWITCHCAPVCC, 0x3C);  

    button_estate[0] = HIGH;
    button_estate[1] = HIGH;
    
    
    WiFiMulti.addAP(WIFISID, WIFIPASS);
 
    Serial.println();
    Serial.println();
    Serial.print("Eperando a conectar a la WiFi... ");
	display.clearDisplay();

    display.drawBitmap(0, 0, Ixhua, 128, 64, WHITE);
	display.display();
    
    while (WiFiMulti.run() != WL_CONNECTED) {
    Serial.print(".");
    digitalWrite(INDICADOR,HIGH);
    delay(500);
    digitalWrite(INDICADOR,LOW);
    delay(500);
    }
 
    Serial.println("");
    Serial.println("WiFi conectada"); 
    Serial.println("Direccion IP: ");
    Serial.println(WiFi.localIP());
 
    delay(500);
 
    //Establecemos la semilla en un pin analogico
    randomSeed(analogRead(A0));
	

}

void loop() {

    int Temperatura = dht.readTemperature();    
    int HumedadA = dht.readHumidity();
    int HumedadS = LecturaHG();
 

     switch (state)
 {
    case S_HOME:

    Serial.println("HOME");
    digitalWrite(INDICADOR,LOW);
    delay(500);
    ejecutado = false;
	
      if (HumedadS >= 20){
           display.clearDisplay();

           display.drawBitmap(0, 0,  Happy, 128, 64, WHITE);
	       display.display();
           
           state = S_HOME;
        }


       if (flancoSubida(BTN_U)){
           state = S_MENU;
            break;
          
        }

        if (HumedadS < 20){
           display.clearDisplay();
           display.setTextColor(WHITE);
	       display.setCursor(5,24);
	       display.setTextSize(2);
	       display.println("Need Water");
	       display.display();
           delay(50);
           state = S_HOME;
        }


        
        if (Temperatura > 40){
           display.clearDisplay();
           display.setTextColor(WHITE);
	       display.setCursor(5,24);
	       display.setTextSize(2);
	       display.println("Too hot");
	       display.display();
           delay(50);
           state = S_HOME;
        }


        
    break;

    case S_MENU:
    
    Serial.println("MENU");
    delay(500);
    
    digitalWrite(INDICADOR,HIGH);
    // Display ASCII Characters
    display.clearDisplay();
    display.setCursor(0,0);
    display.setTextSize(2);
    display.print(Temperatura);
    display.println(" Grados ");
    display.print("HA: "); 
    display.print(HumedadA);
    display.println("%");
    display.print("HS: ");
    display.print(HumedadS);
    display.println("%");
    display.display();
    
    
    if (!ejecutado)
    {
    Serial.println(Temperatura);
    Serial.println(HumedadA);
    Serial.println(HumedadS);
 
    enviar_datos(Temperatura, HumedadA, HumedadS);
    delay(1000);
    ejecutado = true;
    break;
    }

      if (flancoSubida(BTN_U)){
          state = S_HOME;
          break;
        
        }

      break;

   
   
 }





}

void enviar_datos(int valor1, int valor2, int valor3)
{
  // Cerramos cualquier conexión anterior
  if (client.connected())
  {
    client.stop();
  }
 
  // Esperamos hasta que se hayan enviado todos los datos
  client.flush();

 client.setInsecure();
  // Hacemos la petición mediante SSL
  if (client.connect(HOSTIFTTT, 443)) {
    // Construimos la petición HTTP
    String toSend = "POST /trigger/";
    toSend += EVENTO;
    toSend += "/with/key/";
    toSend += IFTTTKEY;
    toSend += "?value1=";
    toSend += valor1;
    toSend += "&value2=";
    toSend += valor2;
    toSend += "&value3=";
    toSend += valor3;
    toSend += " HTTP/1.1\r\n";
    toSend += "Host: ";
    toSend += HOSTIFTTT;
    toSend += "\r\n";
    toSend += "Connection: close\r\n\r\n";
 
    client.print(toSend);
   
  }
 
  // Esperamos hasta que se hayan enviado todos los datos
  client.flush();
  // Desconectamos del cliente
  client.stop();
}


int LecturaHG(){

  int valorHumedad = map(analogRead(SGROUND), 0, 1023, 100, 0);
  return valorHumedad;
  }


void robojaxText(String text, int x, int y, int size , boolean d){
    display.setTextSize(size);
    display.setTextColor(WHITE);
    display.setCursor(x,y);
    display.println(text);
    if(d){
        display.display();
    }

}